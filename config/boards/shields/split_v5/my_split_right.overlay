#include "split_v5.dtsi"

/*
 * col-offset = <9> shifts the right side's local column scan (0-9)
 * into global columns (9-18) in the shared default_transform.
 * This makes right-side key positions land at indices 39-82 in the keymap,
 * immediately after the left side's 39 keys.
 */
&default_transform {
    col-offset = <9>;
};

&kscan0 {
    /* ── REPLACE THESE ROW PINS with your actual wiring ── */
    row-gpios = <&pro_micro 10 (GPIO_ACTIVE_HIGH | GPIO_PULL_DOWN)>,
                <&pro_micro 16 (GPIO_ACTIVE_HIGH | GPIO_PULL_DOWN)>,
                <&pro_micro 14 (GPIO_ACTIVE_HIGH | GPIO_PULL_DOWN)>,
                <&pro_micro 15 (GPIO_ACTIVE_HIGH | GPIO_PULL_DOWN)>,
                <&pro_micro 18 (GPIO_ACTIVE_HIGH | GPIO_PULL_DOWN)>;

    /* ── REPLACE THESE COLUMN PINS with your actual wiring ── */
    col-gpios = <&pro_micro 1  (GPIO_ACTIVE_HIGH)>,
                <&pro_micro 0  (GPIO_ACTIVE_HIGH)>,
                <&pro_micro 14 (GPIO_ACTIVE_HIGH)>,
                <&pro_micro 19 (GPIO_ACTIVE_HIGH)>,
                <&pro_micro 20 (GPIO_ACTIVE_HIGH)>,
                <&pro_micro 9  (GPIO_ACTIVE_HIGH)>,
                <&pro_micro 8  (GPIO_ACTIVE_HIGH)>,
                <&pro_micro 7  (GPIO_ACTIVE_HIGH)>,
                <&pro_micro 6  (GPIO_ACTIVE_HIGH)>,
                <&pro_micro 5  (GPIO_ACTIVE_HIGH)>;
};
