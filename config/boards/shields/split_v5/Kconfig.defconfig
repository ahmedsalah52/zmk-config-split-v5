## config/boards/shields/split_v5/Kconfig.defconfig
```kconfig
if SHIELD_MY_SPLIT_LEFT

config ZMK_KEYBOARD_NAME
    default "My Split Left"

endif

if SHIELD_MY_SPLIT_RIGHT

config ZMK_KEYBOARD_NAME
    default "My Split Right"

endif
```
